## Kconfig
```kconfig
menu "lcl"
    menu "vect"
        
            
        menu "capacity expansion"

            config LCL_VECT_CAP_DOUBLE
                bool "Double the capacity each expansion"
                default y

            config LCL_VECT_CAP_ADDER
                int "Add constant to capacity each expansion"
                depends on !LCL_VECT_CAP_DOUBLE
                default 32

        endmenu


    endmenu
endmenu
```
